/******************************************************************************
 * @file     qspi_baozi_test.c
 * @brief    高分辨率包子动画：绕屏幕中心自转 + 竖直小幅上下浮动（持续循环）
 *
 * 硬件：TD1601 EVB 扩展板 CON2 QSPI 屏（TR230S 480x480），
 *       驱动见同目录 qspi_lcd.c。
 *
 * 设计要点（192KB SRAM 限制，无帧缓冲）：
 *   - 包子用纯几何参数化绘制：皮身大圆 + 底部月牙阴影 + 12 条放射褶纹
 *     （其中 1 条深褶破坏对称）+ 中心收口 + 2 点高光；
 *   - 褶纹/高光/收口都"贴在包子表面"，整组绕中心随角度 theta 旋转，
 *     因此能清晰看出包子在自转；
 *   - 浮动 = 包子整体 y 做小幅度正弦上下（FLOAT_A px），同时地面阴影
 *     固定不动，强化"上下移动"感；
 *   - sin/cos 用整数定点查表（无 libm 依赖），角度全为整数度；
 *   - 每帧只用固定几个大窗口 + 若干小圆点窗口重绘包子区域，无残留。
 *
 * 入口：qspi_baozi_test() —— 由 src/main.c 调用
 ******************************************************************************/

#include <stdio.h>
#include <stdint.h>
#include "qspi_lcd.h"

/* ==================== 配色（RGB565） ==================== */
#define COL_BG      QSPI_RGB565(186, 222, 248)   /* 背景：淡天蓝 */
#define COL_DOUGH   QSPI_RGB565(255, 240, 211)   /* 包子皮：米白 */
#define COL_EDGE    QSPI_RGB565(203, 168, 128)   /* 底部月牙/皮边：浅棕 */
#define COL_FOLD    QSPI_RGB565(174, 133, 95)    /* 普通褶影：中棕 */
#define COL_DEEP    QSPI_RGB565(133, 92, 60)     /* 深褶/收口深色 */
#define COL_COLLAR  QSPI_RGB565(110, 78, 56)     /* 中心收口 */
#define COL_HILITE  QSPI_COLOR_WHITE             /* 高光 */
#define COL_SHADOW  QSPI_RGB565(152, 170, 202)   /* 地面阴影（静态） */

/* ==================== 布局（480x480） ==================== */
#define CX          240                 /* 包子中心 x（固定） */
#define CY_BASE     248                 /* 包子中心 y 基准 */
#define FLOAT_A     11                  /* 上下浮动幅度 px */
#define R_DOUGH     150                 /* 包子主体半径 */
#define R_COVER     180                 /* 每帧背景覆盖圆半径（盖住历史位置） */

/* 地面阴影（固定画一次，低于包子浮动范围） */
#define SHADOW_CY   448
#define SHADOW_RX   128
#define SHADOW_RY   12

/* ==================== 整数定点 sin 表（×4096，角度 0..359） ==================== */
static const int16_t g_sin12[360] = {
    0, 71, 143, 214, 286, 357, 428, 499, 570, 641, 711, 782, 852, 921, 991, 1060,
    1129, 1198, 1266, 1334, 1401, 1468, 1534, 1600, 1666, 1731, 1796, 1860, 1923, 1986, 2048, 2110,
    2171, 2231, 2290, 2349, 2408, 2465, 2522, 2578, 2633, 2687, 2741, 2793, 2845, 2896, 2946, 2996,
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    -570, -499, -428, -357, -286, -214, -143, -71
};

static inline int cos12(int deg)   { return g_sin12[((deg + 90) % 360 + 360) % 360]; }
static inline int sin12(int deg)   { return g_sin12[((deg % 360) + 360) % 360]; }

/* 包子表面一点（与包子相对极坐标 r/ang_deg），按旋转角 theta 与中心 cy 定位 */
static void spot(int cx, int cy, int r, int ang, int rr, uint16_t color)
{
    int x = cx + ((r * cos12(ang) + 2048) >> 12);
    int y = cy + ((r * sin12(ang) + 2048) >> 12);
    qspi_fill_circle(x, y, rr, color, COL_DOUGH);
}

/* ==================== 单帧绘制 ==================== */
static void draw_baozi(int cy, int theta)
{
    int i, k;

    /* 0. 固定圆心背景覆盖圆（out=BG 无痕，清掉上一帧包子所有位置） */
    qspi_fill_circle(CX, CY_BASE, R_COVER, COL_BG, COL_BG);

    /* 1. 底部月牙：先画整体下移 8px 的深色圆，再画主体圆盖住，留出下缘阴影 */
    qspi_fill_circle(CX, cy + 8, R_DOUGH, COL_EDGE, COL_BG);
    qspi_fill_circle(CX, cy,     R_DOUGH, COL_DOUGH, COL_BG);

    /* 2. 放射褶纹：12 条沿表面转动的弧线，0 号深褶更长更粗（破对称） */
    for (k = 0; k < 12; k++) {
        int deep = (k == 0);
        int r0 = deep ? 34 : 58;            /* 内端半径 */
        int r1 = deep ? 142 : 124;          /* 外端半径 */
        int pr = deep ? 4 : 3;              /* 点半径 */
        uint16_t col = deep ? COL_DEEP : COL_FOLD;
        int a0 = theta + k * 30 - 8;        /* 内端角（弧度弯曲起点） */
        for (i = 0; i <= 9; i++) {
            int r  = r0 + (r1 - r0) * i / 9;
            int a  = a0 + (16 * i) / 9;     /* 内->外角增 16 度，形成旋弯 */
            spot(CX, cy, r, a, pr, col);
        }
    }

    /* 3. 中心收口：小圆 + 内部深点（随包子整体浮动，不随褶转） */
    qspi_fill_circle(CX, cy, 13, COL_COLLAR, COL_DOUGH);
    qspi_fill_circle(CX, cy, 5, COL_DEEP, COL_COLLAR);

    /* 4. 高光：两白点贴在表面随包子转动（out=DOUGH 无痕） */
    spot(CX, cy, 92, theta + 205, 15, COL_HILITE);
    spot(CX, cy, 114, theta + 118, 7, COL_HILITE);
}

/* ==================== 测试入口（持续显示，不黑屏） ==================== */
void qspi_baozi_test(void)
{
    int theta = 0;      /* 自转角度（度） */
    int phase = 0;      /* 浮动相位（度） */

    qspi_lcd_init();

    /* 首帧：整屏背景 + 地面阴影（一次，之后只更新包子区域） */
    qspi_fill_rect(0, 0, QSPI_LCD_W, QSPI_LCD_H, COL_BG);
    qspi_fill_ellipse(CX, SHADOW_CY, SHADOW_RX, SHADOW_RY, COL_SHADOW, COL_BG);

    printf("[baozi] spin + float animation start\r\n");

    for (;;) {
        int dy = (FLOAT_A * g_sin12[phase] + 2048) >> 12;   /* 上下浮动偏移 */
        draw_baozi(CY_BASE + dy, theta);

        theta = (theta + 2) % 360;      /* 自转：2°/帧 */
        phase = (phase + 5) % 360;      /* 浮动相位：5°/帧 */
    }
}

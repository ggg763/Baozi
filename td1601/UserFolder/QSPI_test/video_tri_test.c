/******************************************************************************
 * @file     video_tri_test.c
 * @brief    全屏流式渲染：黄色等边三角形绕屏幕中心 360° 原地自转
 *
 * 底座：官方 video.c + "每帧一次全屏 RAMWR 事务、像素 CPU 合成"（已验证
 * 可靠，干净稳定）。本文件把之前失败的旋转三角形用该底座重做：
 *   - 三角形三顶点每帧按角度 theta 旋转（整数定点 sin/cos 表，无 libm）
 *   - 逐像素用"当前帧顶点"的边函数 + 重心符号判断黄/浅蓝
 *   - 无 DMA、无局部窗口、无帧缓冲
 *
 * 帧率估算：整屏 230400 像素轮询发送为主（同全屏纯色填充量级），
 * 每帧约几十~百 ms，theta 每帧 +3° 约为 ~8s/圈。
 *
 * 入口：video_tri_test() —— 由 src/main.c 调用
 ******************************************************************************/

#include <stdio.h>
#include <stdint.h>
#include "video.h"              /* video_init / HAL_Delay */

/* video.h 未声明的官方原语（video.c 中定义），此处补声明 */
extern void LCD_Set_Window(uint16_t sx, uint16_t sy, uint16_t width, uint16_t height);
extern void LCD_startWriteMutileData(void);
extern void LCD_endWriteMutileData(void);
extern void LCD_WritemutileData16_fast(uint16_t num);

/* ==================== 配色（RGB565 手算常量） ==================== */
#define COL_BG   0xBEFF     /* 浅蓝 (186,222,248) */
#define COL_YEL  0xFF48     /* 黄   (255,232,64)  */

/* ==================== 旋转参数 ==================== */
#define CX       240
#define CY       240
#define R_TRI    150                 /* 外接半径 */

/* ==================== 整数定点 sin 表（×4096，角度 0..359） ==================== */
static const int16_t g_sin12[360] = {
    0, 71, 143, 214, 286, 357, 428, 499, 570, 641, 711, 782, 852, 921, 991, 1060,
    1129, 1198, 1266, 1334, 1401, 1468, 1534, 1600, 1666, 1731, 1796, 1860, 1923, 1986, 2048, 2110,
    2171, 2231, 2290, 2349, 2408, 2465, 2522, 2578, 2633, 2687, 2741, 2793, 2845, 2896, 2946, 2996,
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    -570, -499, -428, -357, -286, -214, -143, -71
};

static inline int cos12(int deg) { return g_sin12[((deg + 90) % 360 + 360) % 360]; }
static inline int sin12(int deg) { return g_sin12[((deg % 360) + 360) % 360]; }

/* ==================== 单帧渲染 ==================== */
static void draw_rot_triangle(int theta)
{
    /* 旋转后的三个顶点（相隔 120°） */
    int x0 = CX + ((R_TRI * cos12(theta) + 2048) >> 12);
    int y0 = CY + ((R_TRI * sin12(theta) + 2048) >> 12);
    int x1 = CX + ((R_TRI * cos12(theta + 120) + 2048) >> 12);
    int y1 = CY + ((R_TRI * sin12(theta + 120) + 2048) >> 12);
    int x2 = CX + ((R_TRI * cos12(theta + 240) + 2048) >> 12);
    int y2 = CY + ((R_TRI * sin12(theta + 240) + 2048) >> 12);

    /* 包围盒（快速拒绝） */
    int bx0 = x0, bx1 = x0, by0 = y0, by1 = y0;
    if (x1 < bx0) bx0 = x1;  if (x1 > bx1) bx1 = x1;
    if (x2 < bx0) bx0 = x2;  if (x2 > bx1) bx1 = x2;
    if (y1 < by0) by0 = y1;  if (y1 > by1) by1 = y1;
    if (y2 < by0) by0 = y2;  if (y2 > by1) by1 = y2;

    /* 边函数常量 + 重心符号（帧级只算一次） */
    int a0 = y1 - y0, b0 = x0 - x1, c0 = -(a0 * x0 + b0 * y0);
    int a1 = y2 - y1, b1 = x1 - x2, c1 = -(a1 * x1 + b1 * y1);
    int a2 = y0 - y2, b2 = x2 - x0, c2 = -(a2 * x2 + b2 * y2);
    int gx = (x0 + x1 + x2) / 3;
    int gy = (y0 + y1 + y2) / 3;
    int s0 = (a0 * gx + b0 * gy + c0) >= 0 ? 1 : -1;
    int s1 = (a1 * gx + b1 * gy + c1) >= 0 ? 1 : -1;
    int s2 = (a2 * gx + b2 * gy + c2) >= 0 ? 1 : -1;

    LCD_Set_Window(0, 0, 480, 480);
    LCD_startWriteMutileData();

    for (int yy = 0; yy < 480; yy++) {
        int hit_y = (yy >= by0 && yy <= by1);
        for (int xx = 0; xx < 480; xx++) {
            uint16_t col;
            if (hit_y && xx >= bx0 && xx <= bx1) {
                int e0 = a0 * xx + b0 * yy + c0;
                int e1 = a1 * xx + b1 * yy + c1;
                int e2 = a2 * xx + b2 * yy + c2;
                col = (e0 * s0 >= 0 && e1 * s1 >= 0 && e2 * s2 >= 0) ? COL_YEL : COL_BG;
            } else {
                col = COL_BG;
            }
            LCD_WritemutileData16_fast(col);
        }
    }

    LCD_endWriteMutileData();
}

/* ==================== 测试入口 ==================== */
void video_tri_test(void)
{
    int theta = 0;

    video_init();               /* 官方初始化 + 三色自检 */

    printf("[spin] fullscreen-stream rotating triangle\r\n");

    for (;;) {
        draw_rot_triangle(theta);
        theta = (theta + 3) % 360;      /* 3°/帧 原地自转 */
        HAL_Delay(10);
    }
}
